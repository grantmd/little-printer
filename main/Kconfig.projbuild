## main/Kconfig.projbuild
```kconfig
menu "Briefing Printer Config"

config WIFI_SSID
    string "Wi-Fi SSID"
    default ""

config WIFI_PASSWORD
    string "Wi-Fi Password"
    default ""

config PRINT_HOUR
    int "Hour to print briefing (0-23, local time)"
    default 9
    range 0 23

config PRINT_MINUTE
    int "Minute to print briefing (0-59)"
    default 0
    range 0 59

config PRINTER_BAUD
    int "Printer UART baud rate"
    default 9600
    help
      Match the rate reported on the printer's self-test page.

config MESSAGES_BASE_URL
    string "Base URL for the public message queue service"
    default "https://little-printer-msgs.fly.dev"
    help
      Without trailing slash. The C3 fetches GET <url>/pending and POSTs to <url>/confirm.

config MESSAGES_TOKEN
    string "Bearer token for the message queue service"
    default ""
    help
      Must match PRINTER_TOKEN on the Fly.io app. Generate with `openssl rand -hex 32`.

config MESSAGES_START_HOUR
    int "Start of messages waking-hours window (inclusive, local time)"
    default 8
    range 0 23
    help
      The hourly message poll only fires when the local hour is in the
      half-open range [START_HOUR, END_HOUR).

config MESSAGES_END_HOUR
    int "End of messages waking-hours window (exclusive, local time)"
    default 22
    range 1 24

endmenu
```

## sdkconfig.defaults
```kconfig
CONFIG_IDF_TARGET="esp32c3"
CONFIG_MBEDTLS_CERTIFICATE_BUNDLE=y
CONFIG_ESP_MAIN_TASK_STACK_SIZE=8192
CONFIG_ESP_CONSOLE_USB_SERIAL_JTAG=y
CONFIG_FREERTOS_HZ=100
CONFIG_COMPILER_OPTIMIZATION_SIZE=y
```
